#include <Wire.h>
#include <rgb_lcd.h>

rgb_lcd lcd; //Initiate "lcd"

//Pin Variables
const int potPin = A0;
const int buttonPin = 3;
const int switchButtonPin = 4;
const int speakerPin = 5;
const int altPin = 6;
const int random_noise_pin = A1;

int currentSpeakerPin = speakerPin;

//Scrolling and Songs
const int maxSong = 15;   //Value of max songs **********!!!!!!***********//
int scrollLevel; //Level that is showing!
int noteIndex = 0;
int song_last_played = -1; //TODO check null value---This is an arbitrary number.
bool shuffleDone;

//Sprites
byte pauseButton[8] = { 0,27,27,27,27,27,27, 0};   //Pause Button Sprite
byte playButton[8]  = { 8,12,14,15,14,12, 8, 0};   //Play Button Sprite
byte shuffleSprite[8] = {4, 15, 21, 17, 17, 21, 30, 4};


//Song Names
String songNames[maxSong][2] {
    {"Poker Face", ""},
    {"Imperial", "March"},
    {"Super Mario", "Bros."},
    {"Never Gonna", "Give You Up"},
    {"Chariots of", "Fire"},
    {"Dont Stop", "Believing"},
    {"Eye of the", "Tiger"},
    {"Fortunate", "Son"},
    {"Hey Jude",""},
    {"I Will", "Survive"},
    {"Lean on", "Me"},
    {"Scry Mnstr", "Nice Sprites"},
    {"Darude","Sandstorm"},
    {"Somewhere", "Over Rainbow"},
    {"Random","Shuffle"}
};

//Used to check when the selected song number changes
int scrollSwitch[2] = {0,0};

const int songList[maxSong][2][10000] = {
  //NOTATIOIN:
  // Each song is an array of 2 arrays. The first one is frequencies, and the second is durations.
  
  //Poker Face - #0
  {
    {220, 220, 220, 220, 220, 220, 329, 329, 329, 329, 220, 220, 220,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 261, -1},
    {494, 1, 251, 1, 251, 1, 251, 1, 251, 1, 251, 1, 251,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 755, -1}
  },
  
  //Imperial March - #1
  {
    {195, 195, 195, 195, 195, 195, 155, 155, 233, 233, 195, 195, 155,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 195, -1},
    {498, 1, 498, 1, 498, 1, 373, 1, 123, 1, 498, 1, 373,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 498, -1}
  },

  //Super Mario Bros - #2
  {
    {329, 329, 329, 329, 329, 329, 261, 261, 329, 329, 391, 391, 195,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 164, -1},
    {240, 1, 248, 251, 248, 251, 248, 1, 498, 1, 498, 501, 498,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 1498, -1}
  },

  //Never Gonna Give you Up - #3
  {
    {466, 466, 523, 523, 523, 523, 587, 587, 698, 698, 622, 622, 587,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 466, -1},
    {740, 1, 1248, 1, 748, 1, 748, 1, 123, 1, 123, 1, 123,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 998, -1}
  },

  //Chariots of fire - #4
  {
    {233, 233, 349, 349, 233, 233, 311, 311, 349, 349, 391, 391, 349,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 233, -1},
    {831, 1, 2500, 418, 414, 1, 276, 1, 276, 1, 276, 1, 831,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 3331, -1}
  },

  //Don't Stop Believing - #5
  {
    {415, 415, 246, 246, 415, 415, 246, 246, 415, 415, 246, 246, 415,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 987, -1},
    {248, 1, 248, 1, 248, 1, 248, 1, 248, 1, 248, 1, 248,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 998, -1}
  },

  //Eye of the Tiger - #6
  {
    {349, 349, 349, 349, 311, 311, 349, 349, 349, 349, 311, 311, 349,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 349, -1},
    {534, 536, 400, 1, 400, 1, 802, 536, 400, 1, 400, 1, 802,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 4284, -1}
  },

  //Fortunate Son - #7
  {
    {195, 195, 246, 391, 246, 391, 195, 195, 220, 349, 220, 349, 195,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 391, -1},
    {233, 0, 0, 1639, 0, 0, 233, 0, 0, 1639, 0, 0, 233,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 2108, -1}
  },

  //Hey Jude - #8
  {
    {261, 261, 220, 220, 220, 220, 261, 261, 293, 293, 195, 195, 195,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 261, -1},
    {831, 0, 2081, 1, 414, 1, 414, 1, 414, 1, 1664, 835, 414,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 3331, -1}
  },

  //I will survive - #9
  {
    {391, 391, 440, 440, 440, 440, 440, 440, 440, 440, 440, 440, 493,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 329, -1},
    {748, 1, 248, 1, 248, 1, 248, 1, 123, 1, 373, 251, 248,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 998, -1}
  },

  //Lean on me - #10
  {
    {349, 349, 349, 349, 391, 391, 440, 440, 466, 466, 466, 466, 440,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 233, -1},
    {1498, 1, 498, 1, 248, 1, 498, 1, 1748, 1, 498, 1, 248,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 1498, -1}
  },

  //Scary monsters and nice sprites - #11
  {
    {783, 698, 783, 932, 783, 1174, 1046, 932, 698, 932, 880, 698, 622,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 391, -1},
    {250.0, 250.0, 250.0, 500.0, 250.0, 250.0, 250.0, 250.0, 500.0, 250.0, 250.0, 250.0, 250.0,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 500.0, -1}
  },

  //Darude Sandstorm - #12
  {
    {493, 493, 493, 493, 493, 659, 659, 659, 587, 587, 587, 440, 493,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 659, -1},
    {375, 375, 250, 375, 375, 250, 375, 375, 250, 375, 375, 250, 375,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 2000, -1}
  },

  //Somewhere over the rainbow - #12
  {
    {523, 523, 1046, 1046, 987, 987, 783, 783, 880, 880, 987, 987, 1046,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 1046, -1},
    {1873, 1, 1873, 1, 935, 1, 466, 1, 466, 1, 935, 1, 935,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 3748, -1}
  }
};

//Time Variables
unsigned long currentTime;
unsigned long currentTimeSwitch;
unsigned long time_since_last_press = 0;
unsigned long time_since_last_press_alt = 0;
const int debounceTime = 250;                  //Milliseconds of buffer time

//Random Variables
int random_period = 0;
int random_trigger = 1;
int random_song;

//Sensors
int potPosition;
bool buttonPosition;
bool switchButtonPosition;

int checkPot_and_scrollLevel(){      //Return scroll value
  potPosition = analogRead(potPin);
  delay(10);
  scrollLevel = map(potPosition,0,1023,0,maxSong);
  if(scrollLevel == maxSong){
    scrollLevel--;
  }
  return scrollLevel;
}

bool checkSelect(){
  currentTime = millis();
  buttonPosition = digitalRead(buttonPin);
  if(buttonPosition == true && millis()>= time_since_last_press + debounceTime){
    time_since_last_press = millis();
    return true;
  }
  else{
    return false;
  }
}

bool checkSwitchSelect(){
  currentTimeSwitch = millis();
  switchButtonPosition = digitalRead(switchButtonPin);
  if (switchButtonPosition == true && millis() >= time_since_last_press_alt + debounceTime){
    time_since_last_press_alt = millis();
    Serial.println("Switch button pressed...");
    return true;
  }
  else {
    return false;
  }
}

//Plays the song
//Uses one parameter, which must be a 2-deminsional array.
//  Must include frequencies in the first part and durations in the second.
void play_song(const int song[2][10000], bool ifShuffleTrue){
  if(song_last_played != scrollLevel || song[0][noteIndex + 1] == -1){
    song_last_played = scrollLevel;
    noteIndex = 0;
  }
  long timeNotePlayed;
  bool shouldBreak;
  
  for (; noteIndex < 10000; noteIndex++) {
    Serial.println(String(currentSpeakerPin));
    tone(currentSpeakerPin, song[0][noteIndex]);
    timeNotePlayed = millis();
    shouldBreak = false;

    random_period++;
    if(random_period >= random_trigger){
      random_screen_color();
      random_period = 0;
    }
   
    while (millis() - timeNotePlayed < song[1][noteIndex]){
      delay(10);
      //Serial.println(checkSelect(buttonPin));
      if(checkSelect() == true){
        Serial.println("Pause button pressed...");
        if (ifShuffleTrue == true){
          noteIndex = 0;
          ifShuffleTrue = false;
          shuffleDone = true;
        }
        shouldBreak = true;
        break;
      }
      pollSwitchButton();
    }
    
    if (shouldBreak == true || song[0][noteIndex + 1] == -1){
      Serial.println("Breaking from song...");
      noTone(currentSpeakerPin);
      lcd.setRGB(255,255,255);
      if (ifShuffleTrue == true){
        noteIndex = 0;
        shuffle();
        break;
      }
      changePlayButton(0);
      break;
    }
  }
}

/*
void play_song(int noteList[],float noteLength[]){
  if(song_last_played != scrollLevel){
    song_last_played = scrollLevel;
    noteIndex = 0;
  }
    for (; noteIndex < 10000; noteIndex++) {
      if(checkSelect() == true || noteList[noteIndex] == -1){
        changePlayButton(0);
        break;
      }                                                                    //Will keep for a few versions
      tone(speakerPin, noteList[noteIndex], noteLength[noteIndex]);
  }
}
*/



void screenScroll(int scrollLevel) {
    //The if statement is for button. Do not use with potentiometer.    
    lcd.clear();
    lcd.setCursor(0, 0);
    lcd.print(scrollLevel + 1);
    lcd.setCursor( (16 - songNames[scrollLevel][0].length() ) / 2 , 0);
    lcd.print(songNames[scrollLevel][0]);
    lcd.setCursor( (16 - songNames[scrollLevel][1].length() ) / 2 , 1);
    lcd.print(songNames[scrollLevel][1]);
    if(song_last_played == scrollLevel){
      changePlayButton(0);
    }
    }
    
void changePlayButton(int state){
  lcd.setCursor(15,0);
  if (state == 0){
    lcd.write(byte(0)); //Pause Button
    }
  else if(state == 1){
    lcd.write(byte(1)); //Play Button
  }
}

void changeSpeakerOutput(int pinNo){
  currentSpeakerPin = pinNo;
}

void pollSwitchButton(){
  if (checkSwitchSelect() == true) {
    noTone(currentSpeakerPin);
    if (currentSpeakerPin == speakerPin){
      currentSpeakerPin = altPin;
      Serial.println("Switching to altpin...");
      Serial.println("Current speaker pin: " + String(currentSpeakerPin));
      Serial.println("altPin value: " + String(altPin));
    }
    else {
      currentSpeakerPin = speakerPin;
      Serial.println("Switching to main speaker pin...");
      Serial.println("Current speaker pin: " + String(currentSpeakerPin));
    }
  }
}

void shuffle(){
  shuffleDone = false;
  while (true){
    int randomVariable = randomNumber(true);
    int lastSongPlayed;
    while(randomVariable == lastSongPlayed){
      randomVariable = randomNumber(true);
    }
    lastSongPlayed = randomVariable;
    screenScroll(lastSongPlayed);
    lcd.setCursor(15,1);
    lcd.write(byte(2));
    changePlayButton(1);
    delay(750);
    play_song(songList[randomVariable],true);
    if (shuffleDone = true){
      screenScroll(maxSong - 1);
      break;    
    }
  }
}

int randomNumber(bool ifShuffle){
  if(ifShuffle == true){
    int randomVariable = random(0,maxSong - 1);
    return randomVariable;
  }
  else{
    int randomVariable = random(0,256);
    return randomVariable;
  }
}

void random_screen_color(){
  lcd.setRGB(randomNumber(false),randomNumber(false),randomNumber(false));
}

void setup() {
  Serial.begin(9600);
  pinMode(potPin,INPUT);
  pinMode(buttonPin, INPUT);
  pinMode(switchButtonPin, INPUT);
  pinMode(speakerPin, OUTPUT);
  pinMode(altPin, OUTPUT);
  lcd.begin(16, 2);
  lcd.createChar(0, pauseButton);
  lcd.createChar(1, playButton);
  lcd.createChar(2, shuffleSprite);
  randomSeed(analogRead(random_noise_pin));
  screenScroll(checkPot_and_scrollLevel());
 }


void loop() {
  //Checks to see if button is not pressed.
  if (checkSelect() == false) {
    //Next few lines check to see if you scrolled to a different song.
    scrollSwitch[0] = scrollSwitch[1];
    scrollSwitch[1] = checkPot_and_scrollLevel();
    if (scrollSwitch[0] != scrollSwitch[1]) {
      screenScroll(checkPot_and_scrollLevel());
    }
    pollSwitchButton();

  } else {
      changePlayButton(1);
      if(scrollLevel == maxSong - 1){
        Serial.println("Shuffle Started");
        shuffle();
    }
     else{
        play_song(songList[scrollLevel],false);
    }
  }
}
