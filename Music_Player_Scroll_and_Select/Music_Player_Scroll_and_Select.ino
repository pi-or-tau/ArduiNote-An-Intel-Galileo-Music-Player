#include <Wire.h>
#include <rgb_lcd.h>

rgb_lcd lcd; //Initiate "lcd"

//Pin Variables
const int potPin = A0;
const int buttonPin = 3;
const int speakerPin = 5;
const int random_noise_pin = A1;

//Scrolling and Songs
const int maxSong = 4;   //Value of max songs **********!!!!!!***********//
int scrollLevel; //Level that is showing!
int noteIndex = 0;
int song_last_played = -1; //TODO check null value---This is an arbitrary number.

//Sprites
byte pauseButton[8] = { 0,27,27,27,27,27,27, 0};   //Pause Button Sprite
byte playButton[8]  = { 8,12,14,15,14,12, 8, 0};   //Play Button Sprite

//Song Names
String songNames[][2] {
    {"Poker Face", ""},
    {"Imperial", "March"},
    {"Super Mario", "Bros."},
    {"Nvr Gonna", "give you up"}
};

/*
int max_and_min_Freq[][2]{
  {164,349},   //Poker Face
  {155,391},   //Imperial March
  {146,523},   //Super Mario Bros.
};*/

//Song Notes
const int POKER_FACE_NOTE_LIST[] = {220, 220, 220, 220, 220, 220, 329, 329, 329, 329, 220, 220, 220,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 261, -1};
const int IMPERIAL_MARCH_NOTE_LIST[] = {195, 195, 195, 195, 195, 195, 155, 155, 233, 233, 195, 195, 155,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 195, -1};
const int SUPER_MARIO_BROS_NOTE_LIST[] = {329, 329, 329, 329, 329, 329, 261, 261, 329, 329, 391, 391, 195,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 164, -1};
const int NEVER_GONNA_GIVE_YOU_UP_NOTE_LIST[] = {466, 466, 523, 523, 523, 523, 587, 587, 698, 698, 622, 622, 587,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 466, -1};

//Note Lengths
const float POKER_FACE_NOTE_LENGTHS[] = {494.7491937499999, 1.0504229166666665, 251.0510770833333, 1.0504229166666665, 251.0510770833333, 1.0504229166666665, 251.0510770833333, 1.0504229166666665, 251.0510770833333, 1.0504229166666665, 251.0510770833333, 1.0504229166666665, 251.0510770833333,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 1.0504229166666665, 755.2540770833332};
const float IMPERIAL_MARCH_NOTE_LENGTHS[] = {498.9583333333333, 1.0416666666666667, 498.9583333333333, 1.0416666666666667, 498.9583333333333, 1.0416666666666667, 373.9583333333333, 1.0416666666666667, 123.95833333333334, 1.0416666666666667, 498.9583333333333, 1.0416666666666667, 373.9583333333333,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 1.0416666666666667, 498.9583333333333};
const float SUPER_MARIO_BROS_NOTE_LENGTHS[] = {240.625, 1.0416666666666667, 248.95833333333334, 251.04166666666666, 248.95833333333334, 251.04166666666666, 248.95833333333334, 1.0416666666666667, 498.9583333333333, 1.0416666666666667, 498.9583333333333, 501.04166666666663, 498.9583333333333,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 1498.9583333333335, -1};
const float NEVER_GONNA_GIVE_YOU_UP_NOTE_LENGTHS[] = {740.625, 1.0416666666666667, 1248.9583333333335, 1.0416666666666667, 748.9583333333333, 1.0416666666666667, 748.9583333333333, 1.0416666666666667, 123.95833333333334, 1.0416666666666667, 123.95833333333334, 1.0416666666666667, 123.95833333333334,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 998.9583333333333, -1};

//Time Variables
unsigned long currentTime;
unsigned long time_since_last_press = 0;
const int debounceTime = 250;                  //Milliseconds of buffer time

//Random Variables
int random_period = 0;
int random_trigger = 5;

//Sensors
int potPosition;
bool buttonPosition;
//bool buttonTrue;

//Play+Pause
bool pauseTrue;
bool playTrue;

int checkPot_and_scrollLevel(){      //Return scroll value
  potPosition = analogRead(potPin);
  delay(10);
  scrollLevel = map(potPosition,0,1023,0,maxSong);
  if(scrollLevel == maxSong){
    scrollLevel--;
  }
  return scrollLevel;
}

bool checkSelect(){
  currentTime = millis();
  buttonPosition = digitalRead(buttonPin);
  if(buttonPosition == true && millis()>= time_since_last_press + debounceTime){
    time_since_last_press = millis();
    return true;
  }
  else{
    return false;
  }
}

void play_song(const int noteList[],const float noteLength[]){
  if(song_last_played != scrollLevel || noteList[noteIndex + 1] == -1){
    song_last_played = scrollLevel;
    noteIndex = 0;
  }
  long timeNotePlayed;
  bool shouldBreak;
  
  for (; noteIndex < 10000; noteIndex++) {
    tone(speakerPin, noteList[noteIndex]);
    timeNotePlayed = millis();
    shouldBreak = false;

    random_period++;
    if(random_period >= random_trigger){
      random_screen_color();
      random_period = 0;
    }
   
    while (millis() - timeNotePlayed < noteLength[noteIndex]){
      delay(10);
      if(checkSelect() == true){
        shouldBreak = true;
        break;
      }
    }
    if (shouldBreak == true || noteList[noteIndex + 1] == -1){
      noTone(speakerPin);
      lcd.setRGB(255,255,255);
      changePlayButton(0);
      break;
    }
  }
}

/*
void play_song(int noteList[],float noteLength[]){
  if(song_last_played != scrollLevel){
    song_last_played = scrollLevel;
    noteIndex = 0;
  }
    for (; noteIndex < 10000; noteIndex++) {
      if(checkSelect() == true || noteList[noteIndex] == -1){
        changePlayButton(0);
        break;
      }                                                                    //Will keep for a few versions
      tone(speakerPin, noteList[noteIndex], noteLength[noteIndex]);
  }
}
*/



void screenScroll(int scrollLevel) {
    //The if statement is for button. Do not use with potentiometer.    
    lcd.clear();
    lcd.setCursor(0, 0);
    lcd.print(scrollLevel + 1);
    lcd.setCursor( (16 - songNames[scrollLevel][0].length() ) / 2 , 0);
    lcd.print(songNames[scrollLevel][0]);
    lcd.setCursor( (16 - songNames[scrollLevel][1].length() ) / 2 , 1);
    lcd.print(songNames[scrollLevel][1]);
    if(song_last_played == scrollLevel){
      changePlayButton(0);
    }
    delay(5);
    }
    
void changePlayButton(int state){
  //state = (state + 1) % 2;
  if (state == 0){
    lcd.setCursor(15,0);
    lcd.write(byte(0)); //Pause Button
    delay(10);
    }
  else if(state == 1){
    lcd.setCursor(15,0);
    lcd.write(byte(1)); //Play Button
    delay(5);
  }
}

int randomNumber(){
  int randomVariable = random();
  return randomVariable;
}

void random_screen_color(){
  lcd.setRGB(randomNumber(),randomNumber(),randomNumber());
}

void setup() {
  Serial.begin(9600);
  pinMode(potPin,INPUT);
  pinMode(buttonPin, INPUT);
  pinMode(speakerPin, OUTPUT);
  lcd.begin(16, 2);
  lcd.createChar(0, pauseButton);
  lcd.createChar(1, playButton);
  randomSeed(analogRead(random_noise_pin));
  screenScroll(checkPot_and_scrollLevel());
 }

void loop() {
  while(checkSelect() == false){
    screenScroll(checkPot_and_scrollLevel());
  }
  if (scrollLevel == 0){
    changePlayButton(1);
    play_song(POKER_FACE_NOTE_LIST,POKER_FACE_NOTE_LENGTHS);
  }
  if(scrollLevel == 1){
    changePlayButton(1);
    play_song(IMPERIAL_MARCH_NOTE_LIST,IMPERIAL_MARCH_NOTE_LENGTHS);
  }
  if(scrollLevel == 2){
    changePlayButton(1);
    play_song(SUPER_MARIO_BROS_NOTE_LIST,SUPER_MARIO_BROS_NOTE_LENGTHS);
  }
  if(scrollLevel == 3){
    changePlayButton(1);
    play_song(NEVER_GONNA_GIVE_YOU_UP_NOTE_LIST,NEVER_GONNA_GIVE_YOU_UP_NOTE_LENGTHS);
  }
}


