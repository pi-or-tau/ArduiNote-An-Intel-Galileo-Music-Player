#include <Wire.h>
#include <rgb_lcd.h>

rgb_lcd lcd; //Initiate "lcd"

//Pin Variables
const int potPin = A0;
const int buttonPin = 3;
const int speakerPin = 5;
const int random_noise_pin = A1;

//Scrolling and Songs
const int maxSong = 4;   //Value of max songs **********!!!!!!***********//
int scrollLevel; //Level that is showing!
int noteIndex = 0;
int song_last_played = -1; //TODO check null value---This is an arbitrary number.

//Sprites
byte pauseButton[8] = { 0,27,27,27,27,27,27, 0};   //Pause Button Sprite
byte playButton[8]  = { 8,12,14,15,14,12, 8, 0};   //Play Button Sprite

//Song Names
String songNames[maxSong][2] {
    {"Poker Face", ""},
    {"Imperial", "March"},
    {"Super Mario", "Bros."},
    {"Nvr Gonna", "give you up"}
};

//Used to check when the selected song number changes
int scrollSwitch[2] = {0,0};

const int songList[maxSong][2][10000] = {
  //NOTATIOIN:
  // Each song is an array of 2 arrays. The first one is frequencies, and the second is durations.
  
  //Poker Face - #0
  {
    {220, 220, 220, 220, 220, 220, 329, 329, 329, 329, 220, 220, 220,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 261, -1},
    {494, 1, 251, 1, 251, 1, 251, 1, 251, 1, 251, 1, 251,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 755, -1}
  },
  
  //Imperial March - #1
  {
    {195, 195, 195, 195, 195, 195, 155, 155, 233, 233, 195, 195, 155,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 195, -1},
    {498, 1, 498, 1, 498, 1, 373, 1, 123, 1, 498, 1, 373,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 498, -1}
  },

  //Super Mario Bros - #2
  {
    {329, 329, 329, 329, 329, 329, 261, 261, 329, 329, 391, 391, 195,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 164, -1},
    {240, 1, 248, 251, 248, 251, 248, 1, 498, 1, 498, 501, 498,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 1498, -1}
  },

  //Never Gonna Give you Up - #3
  {
    {466, 466, 523, 523, 523, 523, 587, 587, 698, 698, 622, 622, 587,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 466, -1},
    {740, 1, 1248, 1, 748, 1, 748, 1, 123, 1, 123, 1, 123,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 998, -1}
  }
};

//Time Variables
unsigned long currentTime;
unsigned long time_since_last_press = 0;
const int debounceTime = 250;                  //Milliseconds of buffer time

//Random Variables
int random_period = 0;
int random_trigger = 1;

//Sensors
int potPosition;
bool buttonPosition;

int checkPot_and_scrollLevel(){      //Return scroll value
  potPosition = analogRead(potPin);
  delay(10);
  scrollLevel = map(potPosition,0,1023,0,maxSong);
  if(scrollLevel == maxSong){
    scrollLevel--;
  }
  return scrollLevel;
}

bool checkSelect(){
  currentTime = millis();
  buttonPosition = digitalRead(buttonPin);
  if(buttonPosition == true && millis()>= time_since_last_press + debounceTime){
    time_since_last_press = millis();
    return true;
  }
  else{
    return false;
  }
}

//Plays the song
//Uses one parameter, which must be a 2-deminsional array.
//  Must include frequencies in the first part and durations in the second.
void play_song(const int song[2][10000]){
  if(song_last_played != scrollLevel || song[0][noteIndex + 1] == -1){
    song_last_played = scrollLevel;
    noteIndex = 0;
  }
  long timeNotePlayed;
  bool shouldBreak;
  
  for (; noteIndex < 10000; noteIndex++) {
    tone(speakerPin, song[0][noteIndex]);
    timeNotePlayed = millis();
    shouldBreak = false;

    random_period++;
    if(random_period >= random_trigger){
      random_screen_color();
      random_period = 0;
    }
   
    while (millis() - timeNotePlayed < song[1][noteIndex]){
      delay(10);
      if(checkSelect() == true){
        shouldBreak = true;
        break;
      }
    }
    if (shouldBreak == true || song[0][noteIndex + 1] == -1){
      noTone(speakerPin);
      lcd.setRGB(255,255,255);
      changePlayButton(0);
      break;
    }
  }
}

/*
void play_song(int noteList[],float noteLength[]){
  if(song_last_played != scrollLevel){
    song_last_played = scrollLevel;
    noteIndex = 0;
  }
    for (; noteIndex < 10000; noteIndex++) {
      if(checkSelect() == true || noteList[noteIndex] == -1){
        changePlayButton(0);
        break;
      }                                                                    //Will keep for a few versions
      tone(speakerPin, noteList[noteIndex], noteLength[noteIndex]);
  }
}
*/



void screenScroll(int scrollLevel) {
    //The if statement is for button. Do not use with potentiometer.    
    lcd.clear();
    lcd.setCursor(0, 0);
    lcd.print(scrollLevel + 1);
    lcd.setCursor( (16 - songNames[scrollLevel][0].length() ) / 2 , 0);
    lcd.print(songNames[scrollLevel][0]);
    lcd.setCursor( (16 - songNames[scrollLevel][1].length() ) / 2 , 1);
    lcd.print(songNames[scrollLevel][1]);
    if(song_last_played == scrollLevel){
      changePlayButton(0);
    }
    }
    
void changePlayButton(int state){
  lcd.setCursor(15,0);
  if (state == 0){
    lcd.write(byte(0)); //Pause Button
    }
  else if(state == 1){
    lcd.write(byte(1)); //Play Button
  }
}

int randomNumber(){
  int randomVariable = random();
  return randomVariable;
}

void random_screen_color(){
  lcd.setRGB(randomNumber(),randomNumber(),randomNumber());
}

void setup() {
  //Serial.begin(9600);
  pinMode(potPin,INPUT);
  pinMode(buttonPin, INPUT);
  pinMode(speakerPin, OUTPUT);
  lcd.begin(16, 2);
  lcd.createChar(0, pauseButton);
  lcd.createChar(1, playButton);
  randomSeed(analogRead(random_noise_pin));
  screenScroll(checkPot_and_scrollLevel());
 }


void loop() {
  //Checks to see if button is not pressed.
  if (checkSelect() == false) {
    //Next few lines check to see if you scrolled to a different song.
    scrollSwitch[0] = scrollSwitch[1];
    scrollSwitch[1] = checkPot_and_scrollLevel();
    if (scrollSwitch[0] != scrollSwitch[1]) {
      screenScroll(checkPot_and_scrollLevel());
    }
  } else {
    changePlayButton(1);
    play_song(songList[scrollLevel]);
  }
}
